## Documentation/devicetree/bindings/pinctrl/meson,pinctrl.txt
```
== Amlogic Meson pinmux controller ==

Required properties for the root node:
 - compatible: one of "amlogic,meson-txhd-periphs-pinctrl"
		      "amlogic,meson-txhd-aobus-pinctrl"
 - reg: address and size of registers controlling irq functionality

=== GPIO sub-nodes ===

The GPIO bank for the controller is represented as a sub-node and it acts as a
GPIO controller.

Required properties for sub-nodes are:
 - reg: should contain address and size for mux, pull-enable, pull and
   gpio register sets
 - reg-names: an array of strings describing the "reg" entries. Must
   contain "mux", "pull" and "gpio". "pull-enable" is optional and
   when it is missing the "pull" registers are used instead
 - gpio-controller: identifies the node as a gpio controller
 - #gpio-cells: must be 2

=== Other sub-nodes ===

Child nodes without the "gpio-controller" represent some desired
configuration for a pin or a group. Those nodes can be pinmux nodes or
configuration nodes.

Required properties for pinmux nodes are:
 - groups: a list of pinmux groups. The list of all available groups
   depends on the SoC and can be found in driver sources.
 - function: the name of a function to activate for the specified set
   of groups. The list of all available functions depends on the SoC
   and can be found in driver sources.

Required properties for configuration nodes:
 - pins: a list of pin names

Configuration nodes support the generic properties "bias-disable",
"bias-pull-up" and "bias-pull-down", described in file
pinctrl-bindings.txt

=== Example ===

pinctrl_aobus: pinctrl@ff800014{
	compatible = "amlogic,meson-txhd-aobus-pinctrl";
	status = "okay";
	#address-cells = <2>;
	#size-cells = <2>;

	gpio_ao: ao-bank@ff800014{
			reg = <0x0 0xff800014 0x0 0x8>,
					<0x0 0xff80002c 0x0 0x4>,
					<0x0 0xff800024 0x0 0x8>;
			reg-names = "mux", "pull", "gpio";
			gpio-controller;
			#gpio-cells = <2>;
	};

	remote_pins: remote_pin {
			mux {
					pins = "GPIOAO_6";
					function = "ir_in";
				};
	};
};
```

## drivers/amlogic/debug/Kconfig
```kconfig
config AMLOGIC_DEBUG
    boolean "Amlogic kernel debug"
    default n
    help
        This is Amlogic kernel debug

config AMLOGIC_DEBUG_LOCKUP
    boolean "Amlogic lockup debug"
    depends on LOCKUP_DETECTOR
    depends on BOOTPARAM_HARDLOCKUP_PANIC
    depends on BOOTPARAM_SOFTLOCKUP_PANIC
    depends on AMLOGIC_DEBUG
    default n
    help
        This is Amlogic kernel lockup debug.
        Debug lockup in isr and deadlock with irq disabled.
```

## drivers/amlogic/input/adc/Kconfig
```kconfig
#
# ADC drivers
#
# When adding new entries keep the list in alphabetical order
menuconfig AMLOGIC_ADC
	bool "ADC device driver support"
	default n
	help
		Say yes here to build support for Analog Devices AD7785, AD7792, AD7793,
		AD7794 and AD7795 SPI analog to digital converters (ADC).
		If unsure, say N (but it's safe to say "Y").

		To compile this driver as a module, choose M here: the
		module will be called AD7793.

config MESON_AD7793
	tristate "Analog Devices AD7793 and similar ADCs driver"
	depends on SPI
	depends on AMLOGIC_ADC
	select IIO_BUFFER
	select IIO_TRIGGERED_BUFFER
	help
	  Say yes here to build support for Analog Devices AD7785, AD7792, AD7793,
	  AD7794 and AD7795 SPI analog to digital converters (ADC).
	  If unsure, say N (but it's safe to say "Y").

	  To compile this driver as a module, choose M here: the
	  module will be called AD7793.
```

## drivers/amlogic/media/video_processor/videosync/Kconfig
```kconfig
menu "Amlogic videosync support"

config AMLOGIC_VIDEOSYNC
	tristate "amlogic videosync device support"
	select VIDEO_DEV
	select VIDEOBUF_GEN
	default n

	---help---
			Select to enable "Amlogic videosync support.

endmenu
```

## drivers/amlogic/wifi/Kconfig
```kconfig
comment "Amlogic Wifi Driver"

menuconfig AM_WIFI
	boolean "WiFi support"
	default n
	help
		select y to support wifi

if AM_WIFI
config BCMDHD_USE_STATIC_BUF
	boolean "broadcom wifi static buff support"
	depends on AM_WIFI
	default n

source "drivers/amlogic/wifi/bcmdhd/Kconfig"

endif # AM_WIFI
```

## drivers/osmc/Kconfig
```kconfig
source "drivers/osmc/gpu/mali/Kconfig"
source "drivers/osmc/gpu/mali-mg/Kconfig"
source "drivers/osmc/gpu/mali-supp/memory_group_manager/Kconfig"
source "drivers/osmc/wlan/Kconfig"
source "drivers/osmc/videoenhancement/Kconfig"
```

## drivers/osmc/gpu/Kconfig
```kconfig
source "drivers/osmc/gpu/mali/Kconfig"
source "drivers/osmc/gpu/mali-mg/Kconfig"
source "drivers/osmc/gpu/mali-supp/memory_group_manager/Kconfig"
```

## drivers/osmc/videoenhancement/Kconfig
```kconfig
config OSMC_VIDEOENHANCEMENT
        bool "Enable video enhancement TA access"
        default y
        help
          Choose this option to enable OSMC video enhancement support
```

## drivers/osmc/wlan/Kconfig
```kconfig
source "drivers/osmc/wlan/bcmdhd/Kconfig"
source "drivers/osmc/wlan/rtl8822CS/Kconfig"
```

## drivers/osmc/wlan/rtl8822BS/Kconfig
```kconfig
config RTL8822BS
	tristate "Realtek 8822B SDIO WiFi"
	---help---
	  Help message of RTL8822BS

config RTL8822BS_OARS_CONCUR
        bool "Enable OARS concur support"
```

## drivers/osmc/wlan/rtl8822CS/Kconfig
```kconfig
config RTL8822CS
	tristate "Realtek 8822C SDIO WiFi"
	---help---
	  Help message of RTL8822CS

config RTL8822CS_OARS_CONCUR
        bool "Enable OARS concur support"
```
